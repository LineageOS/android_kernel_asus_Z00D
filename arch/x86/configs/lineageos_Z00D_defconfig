## drivers/input/sensors/Kconfig
```kconfig
##
# ASUS G-Sensor & E-compass driver configuration
#

config SENSORS_AK09911
        tristate "AK09911 compass support"
        default n
        depends on I2C
        help
          If you say yes here you get support for Asahi Kasei's
          orientation sensor AK09911.

config SENSORS_KXTJ9
        tristate "KXTJ9 g-sensor sensor"
        depends on I2C
```

## drivers/power/battery/Kconfig
```kconfig
#
#  Copyright (c) 2013, ASUSTek, Inc. All Rights Reserved.
#  Written by chris chang chris1_chang@asus.com
#
#  Battery driver configuration
#

config ME372CG_BATTERY_SMB345
	tristate "SMB345 battery charger driver"
	depends on I2C && ZE500CL
	help
	  Say Y to enable support for the SMB345 switching mode based charger
	  and sysfs. The driver supports controlling charger-enable and
	  current limiting capabilities.

config ME372CG_BATTERY_BQ27520
	tristate "BQ27520 battery driver"
	depends on I2C && ZE500CL
	help
	  Say Y here to enable support for batteries with BQ27520(I2C) chips.

config UPI_BATTERY
	bool "UPI gauge driver"
	depends on I2C
	help
	  Say Y to enable it
```
